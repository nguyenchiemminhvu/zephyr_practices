## test_features/custom_board_r5/Kconfig.ncmv
```kconfig
menu "Test features"

choice EVENT_SCENARIOS
    prompt "Enable different cpp support test scenarios"
    default CPP_SUPPORT_SIMPLE_TEST
    help
        Enable different cpp support test scenarios

config CPP_SUPPORT_SIMPLE_TEST
    bool "CPP_SUPPORT_SIMPLE_TEST"
    help
        CPP_SUPPORT_SIMPLE_TEST

config CPP_SUPPORT_ADVANCED_TEST
    bool "CPP_SUPPORT_ADVANCED_TEST"
    help
        CPP_SUPPORT_ADVANCED_TEST
endchoice

endmenu
```

## test_features/custom_board_r5/lge/j721e_custom_r5/Kconfig.j721e_custom_r5
```kconfig
config BOARD_J721E_CUSTOM_R5
	select SOC_J721E_MAIN_R5F0_0 if BOARD_J721E_CUSTOM_R5_J721E_MAIN_R5F0_0
```

## test_features/custom_board_r5/lge/j721e_custom_r5/board.yml
```yaml
board:
  name: j721e_custom_r5
  full_name: LGE J721E Custom Main R5 Board
  vendor: lge
  socs:
    - name: j721e
```
