## CMakeLists.txt
```
cmake_minimum_required(VERSION 3.20)

find_package(Zephyr REQUIRED HINTS $ENV{ZEPHYR_BASE})
project(test_custom_kconfig)

target_sources(app PRIVATE src/main.c)
```

## Kconfig.ncmv
```
menu "Test features"

config ENABLE_FAILURE_TEST
    bool "Enable failure testing"
    default n
    help
        Enable this option to run system failure simulations.

if ENABLE_FAILURE_TEST

choice FAILURE_TEST_TYPE
    prompt "Select the failure test type"
    default ENABLE_STACK_OVERFLOW_TEST
    help
        Choose the specific failure mode to simulate

config ENABLE_STACK_OVERFLOW_TEST
    bool "Stack overflow test"
    help
        Do recursive function calls

config ENABLE_CRASH_TEST
    bool "Segmentfault test"
    help
        Do dereference pointers

endchoice

endif # ENABLE_FAILURE_TEST

endmenu
```

## prj.conf
```kconfig
CONFIG_ENABLE_FAILURE_TEST=y
CONFIG_ENABLE_STACK_OVERFLOW_TEST=y
CONFIG_ENABLE_CRASH_TEST=y # overrides the choice in Kconfig.ncmv
```

## src/main.c
```c
#include <zephyr/kernel.h>
#include <zephyr/sys/printk.h>

#include <string.h>

#if CONFIG_ENABLE_STACK_OVERFLOW_TEST
__attribute__((noinline)) void force_stack_overflow(volatile int depth)
{
    volatile char heavy_buffer[256];
    heavy_buffer[0] = (char)depth;
    printk("Current recursion depth: %d\n", depth);
    force_stack_overflow(depth + 1);
    printk("%c", heavy_buffer[0]);
}
#endif // CONFIG_ENABLE_STACK_OVERFLOW_TEST

int main(void)
{
#if CONFIG_ENABLE_STACK_OVERFLOW_TEST
    printk("Starting stack overflow demonstration on QEMU Cortex-A72...\n");
    k_msleep(1000);

    force_stack_overflow(1); 
#endif // CONFIG_ENABLE_STACK_OVERFLOW_TEST


#if CONFIG_ENABLE_CRASH_TEST
    printk("Starting crash demonstration on QEMU Cortex-A72...\n");
    k_msleep(1000);
    int *ptr = NULL;
    *ptr = 42; // This will cause a crash (null pointer dereference)
#endif // CONFIG_ENABLE_CRASH_TEST

    printk("All tests completed. System is still running.\n");

    return 0;
}
```
