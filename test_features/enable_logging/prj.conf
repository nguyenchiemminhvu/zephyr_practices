## CMakeLists.txt
```
cmake_minimum_required(VERSION 3.20)

find_package(Zephyr REQUIRED HINTS $ENV{ZEPHYR_BASE})
project(test_enable_logging)

target_sources(app PRIVATE src/main.c)
```

## prj.conf
```kconfig
CONFIG_LOG=y
CONFIG_PRINTK=y
CONFIG_UART_CONSOLE=y
CONFIG_UART_LINE_CTRL=y

# log levels (0=none, 1=error, 2=warning, 3=info, 4=debug)
CONFIG_LOG_DEFAULT_LEVEL=4
CONFIG_LOG_BUFFER_SIZE=1024
CONFIG_LOG_TIMESTAMP_64BIT=y
CONFIG_LOG_BACKEND_SHOW_COLOR=y

CONFIG_LOG_MODE_IMMEDIATE=y
```

## src/main.c
```c
#include <zephyr/kernel.h>
#include <zephyr/logging/log.h>

LOG_MODULE_REGISTER(test_logging, LOG_LEVEL_DBG);

int main(void)
{
    printk("=== Start of the test_enable_logging application ===\n");

    LOG_ERR("This is an error message");
    LOG_WRN("This is a warning message");
    LOG_INF("This is an info message");

#ifdef CONFIG_LOG
    LOG_DBG("This is a debug message");
#endif

    // print a long log line exceed 128 bytes
    LOG_INF("This is a long log message that exceeds 128 bytes. It is used to test the logging functionality in Zephyr RTOS. The message should be properly handled and displayed without any issues.");

    return 0;
}
```
