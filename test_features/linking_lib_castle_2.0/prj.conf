## CMakeLists.txt
```
cmake_minimum_required(VERSION 3.20)

set(CMAKE_CXX_STANDARD 17)
set(CMAKE_CXX_STANDARD_REQUIRED OFF)
set(CMAKE_CXX_EXTENSIONS OFF)

find_package(Zephyr REQUIRED HINTS $ENV{ZEPHYR_BASE})
project(test_linking_castle_2.0)

target_sources(app PRIVATE src/main.cpp)
target_include_directories(app PRIVATE include)

target_compile_options(
    app PRIVATE
    -Wall
    -Wextra
    -Wpedantic
    -DCASTLE_USING_STD_NEW=1
    -DCASTLE_USING_BUILTIN_BIT_CAST=1
    -DCASTLE_USING_STD_INITIALIZER_LIST=0
    -DCASTLE_USING_POSIX_APIS=1
    -DCASTLE_USING_TIMEX=0
    -DCASTLE_USING_PTHREAD=1
    -DCASTLE_USING_IO_CAN_VIA_ZEPHYR=1
    -DCASTLE_USING_LINUX_BSD_SOCKET=0
    -DCASTLE_USING_ZEPHYR_BSD_SOCKET=1
    -DCASTLE_USING_BSD_SOCKET_BASED_HTTP_PROTOCOL=1
    -DCASTLE_USING_BSD_SOCKET_BASED_DNS_PROTOCOL=1
    -DCASTLE_USING_BSD_SOCKET_BASED_MQTT_PROTOCOL=1
    -DCASTLE_USING_BSD_SOCKET_BASED_COAP_PROTOCOL=1
    -DCASTLE_RPMSG_ENABLE_OPENAMP=1
)
```

## prj.conf
```kconfig
CONFIG_MAIN_STACK_SIZE=8192

CONFIG_POSIX_API=y
CONFIG_NETWORKING=y
CONFIG_NET_NAMESPACE_COMPAT_MODE=y
CONFIG_NET_SOCKETS=y
CONFIG_NET_IPV4=y
CONFIG_NET_IPV6=y
CONFIG_NET_TCP=y
CONFIG_NET_UDP=y
CONFIG_CPP=y
CONFIG_STD_CPP17=y
CONFIG_MINIMAL_LIBCPP=y
CONFIG_GLIBCXX_LIBCPP=y
CONFIG_REQUIRES_FULL_LIBCPP=n
CONFIG_CPP_EXCEPTIONS=n
CONFIG_CPP_RTTI=n
CONFIG_NEWLIB_LIBC=n
CONFIG_NEWLIB_LIBC_NANO=n

# Console and logging
CONFIG_PRINTK=y
CONFIG_LOG=y
CONFIG_LOG_BUFFER_SIZE=4096
CONFIG_LOG_DEFAULT_LEVEL=3
CONFIG_UART_CONSOLE=y
CONFIG_UART_LINE_CTRL=y

CONFIG_OPENAMP=y
CONFIG_OPENAMP_SLAVE=n
```

## src/main.cpp
```c
/*
 * Zephyr C++ Static Library Linking Demo
 *
 * Demonstrates linking the castle 1.0 C++ library as a static lib
 * into a Zephyr application with full C++ support enabled.
 */

#include <zephyr/kernel.h>
#include <zephyr/sys/printk.h>

#include "castle/core/compiler.hpp"
#include "castle/core/config.hpp"

#include "castle_ext/io/rpmsg/backends/openamp.hpp"
#include "castle_ext/io/rpmsg/rpmsg.hpp"

/* ── Zephyr application entry point ─────────────────────────────────────── */
int main(void)
{
    printk("=== Zephyr C++ Static Library Linking Demo ===\n");
    printk("    Library: castle 2.0\n\n");

    printk("\nDone.\n");
    return 0;
}
```
