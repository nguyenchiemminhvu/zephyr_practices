## prj.conf
```kconfig
CONFIG_PRINTK=y

# Enable logging infrastructure for safe asynchronous debugging
CONFIG_LOG=y
CONFIG_LOG_DEFAULT_LEVEL=3

CONFIG_SERIAL=y
CONFIG_UART_INTERRUPT_DRIVEN=y
```

## src/main.c
```c
#include <zephyr/kernel.h>
#include <zephyr/device.h>
#include <zephyr/drivers/gpio.h>
#include <zephyr/logging/log.h>
#include <zephyr/sys/util.h>

LOG_MODULE_REGISTER(main, LOG_LEVEL_INF);



int main(void)
{
    

    while (1)
    {
        k_sleep(K_FOREVER);
    }

    return 0;
}
```
