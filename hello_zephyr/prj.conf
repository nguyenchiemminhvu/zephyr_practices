## CMakeLists.txt
```
cmake_minimum_required(VERSION 3.20)

find_package(Zephyr REQUIRED HINTS $ENV{ZEPHYR_BASE})
project(hello_zephyr)

target_sources(app PRIVATE src/main.c)
```

## prj.conf
```kconfig
CONFIG_UART_CONSOLE=y
```

## src/main.c
```c
#include <zephyr/kernel.h>

int main()
{
    printk("Hello Zephyr!\n");
    return 0;
}
```
